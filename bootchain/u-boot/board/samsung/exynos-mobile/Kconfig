## bootchain/u-boot/board/samsung/exynos-mobile/Kconfig
```kconfig
if TARGET_EXYNOS_MOBILE

config ENV_SOURCE_FILE
	default "exynos-mobile"

config LNX_KRNL_IMG_TEXT_OFFSET_BASE
	default TEXT_BASE

config SYS_BOARD
	default "exynos-mobile"

config SYS_CONFIG_NAME
	default "exynos-mobile"

config SYS_VENDOR
	default "samsung"

config EXYNOS9810_EARLY_SAFETY
	bool "Arm Download-mode reboot reason and watchdog at entry (Exynos 9810)"
	help
	  For bring-up: right at entry, make any reset land in Download mode
	  and start the cluster 0 watchdog (~82 s), so a hang recovers
	  without touching the device.

config EXYNOS_MOBILE_RAMLOG
	bool "Copy console output to RAM"
	help
	  Keep everything printed on the console in a RAM buffer at
	  EXYNOS_MOBILE_RAMLOG_ADDR, so the next OS can read it after a reset.

config EXYNOS_MOBILE_RAMLOG_ADDR
	hex "RAM console log address"
	depends on EXYNOS_MOBILE_RAMLOG
	default 0x8ff100000

endif # TARGET_EXYNOS_MOBILE
```

## bootchain/u-boot/configs/exynos9820_defconfig
```kconfig
CONFIG_ARM=y
CONFIG_SKIP_LOWLEVEL_INIT=y
CONFIG_COUNTER_FREQUENCY=26000000
CONFIG_POSITION_INDEPENDENT=y
CONFIG_ARM_SMCCC=y
CONFIG_ARCH_EXYNOS=y
CONFIG_SYS_MALLOC_LEN=0x2000000
CONFIG_SYS_MALLOC_F_LEN=0x16000
CONFIG_TARGET_EXYNOS_MOBILE=y
CONFIG_NR_DRAM_BANKS=6
CONFIG_DEFAULT_DEVICE_TREE="exynos/exynos9820-beyond1lte"
CONFIG_SYS_BOOTM_LEN=0x2000000
CONFIG_SYS_LOAD_ADDR=0x84000000
CONFIG_DEBUG_UART_BASE=0x10440000
CONFIG_DEBUG_UART_CLOCK=133250000
CONFIG_ARMV8_CNTFRQ_BROKEN=y
# CONFIG_PSCI_RESET is not set
CONFIG_DEBUG_UART=y
CONFIG_BUTTON_CMD=y
CONFIG_SAVE_PREV_BL_FDT_ADDR=y
CONFIG_SAVE_PREV_BL_INITRAMFS_START_ADDR=y
CONFIG_SYS_PBSIZE=1024
CONFIG_LOGLEVEL=6
CONFIG_LOG=y
CONFIG_LOG_MAX_LEVEL=8
CONFIG_LOG_DEFAULT_LEVEL=6
CONFIG_BOARD_TYPES=y
# CONFIG_DISPLAY_CPUINFO is not set
CONFIG_MISC_INIT_R=y
CONFIG_HUSH_PARSER=y
CONFIG_CMD_BOOTMENU=y
CONFIG_CMD_PART=y
CONFIG_CMD_POWEROFF=y
CONFIG_CMD_UFS=y
CONFIG_CMD_CACHE=y
CONFIG_CMD_EFIDEBUG=y
CONFIG_CMD_EXT2=y
CONFIG_CMD_EXT4=y
CONFIG_CMD_FAT=y
CONFIG_CMD_FS_GENERIC=y
CONFIG_EFI_PARTITION=y
CONFIG_PARTITION_TYPE_GUID=y
CONFIG_OF_UPSTREAM=y
CONFIG_OF_LIST="exynos/exynos9820-beyond1lte exynos/exynos9820-beyond2lte"
CONFIG_MULTI_DTB_FIT=y
CONFIG_DM_WARN=y
CONFIG_DM_DEBUG=y
CONFIG_BLKMAP=y
CONFIG_BUTTON=y
CONFIG_BUTTON_REMAP_PHONE_KEYS=y
CONFIG_CLK_EXYNOS7870=y
CONFIG_CLK_EXYNOS9820=y
CONFIG_USB_FUNCTION_FASTBOOT=y
CONFIG_FASTBOOT_BUF_ADDR=0xdead0000
CONFIG_FASTBOOT_FLASH=y
CONFIG_FASTBOOT_FLASH_MMC_DEV=0
CONFIG_SYS_I2C_S3C24X0=y
CONFIG_BUTTON_KEYBOARD=y
CONFIG_MISC=y
CONFIG_MMC_BROKEN_CD=y
CONFIG_MMC_IO_VOLTAGE=y
CONFIG_MMC_UHS_SUPPORT=y
CONFIG_MMC_HS400_SUPPORT=y
CONFIG_MMC_DW=y
CONFIG_PHY=y
CONFIG_PHY_EXYNOS_UFS=y
CONFIG_PHY_EXYNOS_USBDRD=y
CONFIG_PINCTRL=y
CONFIG_PINCTRL_EXYNOS78x0=y
CONFIG_PINCTRL_EXYNOS9820=y
CONFIG_DM_PMIC=y
CONFIG_PMIC_S2MPS11=y
CONFIG_DM_REGULATOR=y
CONFIG_DM_REGULATOR_FIXED=y
CONFIG_DM_REGULATOR_S2MPS11=y
CONFIG_SCSI=y
CONFIG_DEBUG_UART_SKIP_INIT=y
CONFIG_SOC_SAMSUNG=y
CONFIG_EXYNOS_PMU=y
CONFIG_SYSRESET=y
CONFIG_SYSRESET_CMD_POWEROFF=y
CONFIG_SYSRESET_SYSCON=y
CONFIG_USB=y
CONFIG_DM_USB_GADGET=y
CONFIG_USB_DWC3=y
CONFIG_USB_DWC3_GENERIC=y
CONFIG_USB_GADGET=y
CONFIG_USB_GADGET_MANUFACTURER="Samsung"
CONFIG_USB_GADGET_VENDOR_NUM=0x04e8
CONFIG_USB_GADGET_PRODUCT_NUM=0x6602
CONFIG_UFS=y
CONFIG_UFS_EXYNOS=y
CONFIG_VIDEO=y
CONFIG_VIDEO_FONT_16X32=y
CONFIG_VIDEO_SIMPLE=y
CONFIG_HEXDUMP=y
```

## bootchain/u-boot/configs/gtactive3wifi_defconfig
```kconfig
CONFIG_ARM=y
CONFIG_SKIP_LOWLEVEL_INIT=y
CONFIG_COUNTER_FREQUENCY=26000000
CONFIG_POSITION_INDEPENDENT=y
CONFIG_ARM_SMCCC=y
CONFIG_ARCH_EXYNOS=y
CONFIG_SYS_MALLOC_LEN=0x2000000
CONFIG_SYS_MALLOC_F_LEN=0x16000
CONFIG_TARGET_EXYNOS_MOBILE=y
CONFIG_NR_DRAM_BANKS=4
CONFIG_DEFAULT_DEVICE_TREE="exynos/exynos9810-gtactive3wifi"
CONFIG_SYS_BOOTM_LEN=0x4000000
CONFIG_SYS_LOAD_ADDR=0x84000000
CONFIG_ARMV8_CNTFRQ_BROKEN=y
CONFIG_SAVE_PREV_BL_FDT_ADDR=y
CONFIG_SAVE_PREV_BL_INITRAMFS_START_ADDR=y
CONFIG_SYS_PBSIZE=1024
CONFIG_LOGLEVEL=6
CONFIG_LOG=y
CONFIG_BOARD_TYPES=y
CONFIG_MISC_INIT_R=y
CONFIG_HUSH_PARSER=y
CONFIG_BOOTDELAY=1
CONFIG_USE_BOOTCOMMAND=y
CONFIG_BOOTCOMMAND="fastboot usb 0"
CONFIG_CMD_BOOTMENU=y
CONFIG_CMD_PART=y
CONFIG_CMD_POWEROFF=y
CONFIG_CMD_UFS=y
CONFIG_CMD_CACHE=y
CONFIG_CMD_EFIDEBUG=y
CONFIG_CMD_EXT2=y
CONFIG_CMD_EXT4=y
CONFIG_CMD_FAT=y
CONFIG_CMD_FS_GENERIC=y
CONFIG_CMD_USB_MASS_STORAGE=y
CONFIG_CMD_FASTBOOT=y
CONFIG_EFI_PARTITION=y
CONFIG_PARTITION_TYPE_GUID=y
CONFIG_OF_UPSTREAM=y
CONFIG_OF_LIST="exynos/exynos9810-gtactive3wifi"
CONFIG_BLKMAP=y
CONFIG_BUTTON=y
CONFIG_BUTTON_GPIO=y
CONFIG_BUTTON_REMAP_PHONE_KEYS=y
CONFIG_BUTTON_KEYBOARD=y
CONFIG_CLK=y
CONFIG_USB_FUNCTION_FASTBOOT=y
CONFIG_FASTBOOT_BUF_ADDR=0x90000000
CONFIG_FASTBOOT_BUF_SIZE=0x10000000
CONFIG_FASTBOOT_OEM_RUN=y
CONFIG_MISC=y
CONFIG_PHY=y
CONFIG_PHY_EXYNOS_UFS=y
CONFIG_PHY_EXYNOS_USBDRD=y
CONFIG_PINCTRL=y
CONFIG_PINCTRL_EXYNOS9810=y
CONFIG_DM_REGULATOR=y
CONFIG_DM_REGULATOR_FIXED=y
CONFIG_SCSI=y
CONFIG_SOC_SAMSUNG=y
CONFIG_EXYNOS_PMU=y
CONFIG_SYSRESET=y
CONFIG_SYSRESET_CMD_POWEROFF=y
CONFIG_SYSRESET_SYSCON=y
CONFIG_USB=y
CONFIG_DM_USB_GADGET=y
CONFIG_USB_DWC3=y
CONFIG_USB_DWC3_GENERIC=y
CONFIG_USB_GADGET=y
CONFIG_USB_GADGET_MANUFACTURER="Samsung"
CONFIG_USB_GADGET_VENDOR_NUM=0x18d1
CONFIG_USB_GADGET_PRODUCT_NUM=0x4ee0
CONFIG_UFS=y
CONFIG_UFS_EXYNOS=y
CONFIG_VIDEO=y
CONFIG_VIDEO_FONT_16X32=y
CONFIG_VIDEO_SIMPLE=y
CONFIG_HEXDUMP=y
# CONFIG_TOOLS_LIBCRYPTO is not set
# CONFIG_TOOLS_KWBIMAGE is not set
# CONFIG_TOOLS_MKEFICAPSULE is not set
# CONFIG_TOOLS_FIT_SIGNATURE is not set
# CONFIG_PSCI_RESET is not set
# CONFIG_DISPLAY_CPUINFO is not set
CONFIG_ENV_SOURCE_FILE="gtactive3wifi"
# CONFIG_REQUIRE_SERIAL_CONSOLE is not set
CONFIG_SYSRESET_PSCI=y
# CONFIG_EXYNOS9810_EARLY_SAFETY is not set
CONFIG_EXYNOS_MOBILE_RAMLOG=y
CONFIG_MULTI_DTB_FIT=y
CONFIG_BUTTON_CMD=y
CONFIG_WDT=y
# CONFIG_WATCHDOG_AUTOSTART is not set
CONFIG_WDT_EXYNOS=y
CONFIG_CMD_WDT=y
CONFIG_CMD_SETEXPR=y
CONFIG_FASTBOOT_FLASH=y
CONFIG_FASTBOOT_FLASH_BLOCK=y
CONFIG_FASTBOOT_FLASH_BLOCK_INTERFACE_NAME="scsi"
CONFIG_FASTBOOT_FLASH_BLOCK_DEVICE_ID=0
CONFIG_EFI_RT_VOLATILE_STORE=y
```

## bootchain/uniLoader/Kconfig
```kconfig
#
# For a description of the syntax of this configuration file,
# see Documentation/kbuild/kconfig-language.txt.
#
mainmenu "uniLoader Configuration"

source "arch/Kconfig"

menu "Building options"
	config CROSS_COMPILE
		string "Cross-compiler tool prefix"
		help
		  Same as running 'make CROSS_COMPILE=prefix-' but stored for
		  default make runs in this kernel build directory.  You don't
		  need to set this unless you want the configured kernel build
		  directory to select the cross-compiler automatically.

	config LOGLEVEL
		int "Verbosity of logs"
		default 7

	config COMPRESS_GZIP
		bool "Compress the uniLoader image with gzip"
		default y
		help
		  Select this if you want to use gzip to compress the final uniLoader image.

	config COMPRESS_LZ4
		bool "Compress the uniLoader image with lz4"
		default n
		help
		  Select this if you want to use lz4 to compress the final uniLoader image.
		  This is required on some new MediaTek devices.

	config EMBED_LINUX
		bool "Embed linux kernel and device tree"
		default y
		help
		  Select this if you want uniLoader to load a linux kernel and device tree

	config KERNEL_PATH
		string "Path to kernel image"
		depends on EMBED_LINUX
		default blob/Image
		help
		  Path to the kernel, which is going to get embedded to uniLoader

	config DT_PATH
		string "Path to device tree image"
		depends on EMBED_LINUX
		default blob/dtb
		help
		  Path to the device tree, which is going to get embedded to uniLoader

	config RAMDISK_PATH
		string "Path to ramdisk image"
		depends on EMBED_LINUX
		default blob/ramdisk
		help
		  Path to the ramdisk, which is going to get embedded to uniLoader
	
	config RAMDISK_NO_COPY
		bool "Do not copy ramdisk"
		depends on EMBED_LINUX
		default n
		help
		  Select this if the bootloader copies the ramdisk itself

	config CHAINLOAD
		bool "Dual payload: chain-load a bootloader, Linux as fallback"
		depends on EMBED_LINUX && LIBFDT
		default n
		help
		  Embed a second payload (an arm64 Image, for example U-Boot) next
		  to Linux. The board decides at boot which one runs: the chained
		  bootloader normally, the embedded Linux after a watchdog reset
		  or when a key is held.

	config CHAINLOAD_PATH
		string "Path to the chained bootloader image"
		depends on CHAINLOAD
		default blob/u-boot.bin

	config CHAINLOAD_ENTRY
		hex "Load and entry address of the chained bootloader"
		depends on CHAINLOAD
		default 0xa0000000

	config CHAINLOAD_FDT_ADDR
		hex "Where the previous bootloader's FDT is copied for it"
		depends on CHAINLOAD
		default 0xa8000000
		help
		  The chained bootloader gets the FDT that the previous bootloader
		  passed in x0 (memory layout, command line), copied here so it
		  cannot be overwritten. Must lie above CHAINLOAD_ENTRY plus the
		  size of the chained image.

	config CHAINLOAD_FDT_MAX
		hex "Largest previous-bootloader FDT that is copied"
		depends on CHAINLOAD
		default 0x200000

	config CHAINLOAD_PREV_FDT_LO
		hex "Lowest address accepted for the previous bootloader's FDT"
		depends on CHAINLOAD
		default 0x80000000

	config CHAINLOAD_PREV_FDT_HI
		hex "End of the range accepted for the previous bootloader's FDT"
		depends on CHAINLOAD
		default 0x100000000

	config CHAINLOAD_HANDOFF_ADDR
		hex "Address of the boot decision record"
		depends on CHAINLOAD
		default 0x0
		help
		  If set, a small record of the boot decision (reset status, keys,
		  previous bootloader FDT, ...) is written here, for the next OS
		  to read. Use memory that survives a reset and that the OS does
		  not map. 0 disables it.

	config CHAINLOAD_DEFAULT
		int "Default payload (0 chained, 1 Linux, 2 watchdog test)"
		depends on CHAINLOAD
		range 0 2
		default 0
		help
		  0: boot the chained bootloader unless the board asks for the
		     fallback.
		  1: always boot the embedded Linux (records the decision only).
		  2: watchdog test: arm the board watchdog as for the chained
		     bootloader and wait for it to reset the SoC (board
		     wdt_test hook); the next boot then picks the embedded Linux.
		     If no reset comes, boot the embedded Linux at once.

endmenu

source "drivers/Kconfig"

source "lib/Kconfig"

source "soc/Kconfig"

source "board/Kconfig"
```

## bootchain/uniLoader/configs/gtactive3wifi_defconfig
```kconfig
CONFIG_POSITION_INDEPENDENT=y
CONFIG_EXYNOS_9810=y
CONFIG_SAMSUNG_GTACTIVE3WIFI=y
CONFIG_TEXT_BASE=0x87000000
CONFIG_PAYLOAD_ENTRY=0x90000000
CONFIG_RAMDISK_ENTRY=0x84000000
CONFIG_FRAMEBUFFER_BASE=0xca000000
CONFIG_FRAMEBUFFER_WIDTH=1200
CONFIG_FRAMEBUFFER_HEIGHT=1920
CONFIG_FRAMEBUFFER_STRIDE=4
```
